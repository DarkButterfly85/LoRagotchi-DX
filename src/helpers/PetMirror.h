// Ported into LoRagotchi from LODESTAR ORION / NOVA (Aries Thorne and Todd Steinhauer).
// Source: wolf_companion src/PetMirror.h. Used with their permission for this LodeStar project.
// The logic is unchanged; the include path <helpers/ui/DisplayDriver.h> already matches LoRagotchi.
// LoRagotchi notes:
//  - name is the pet's own name from /lorafish.id, or the radio's node name when it has none (NovaPetName::frameName);
//    the caller passes it cleaned. (This copy of the encoder is not in the firmware; the live one is examples/companion_radio/NovaPetLink.h.)
//  - uname (the "u" field) is left as "" unless the pet state has a separate owner name.
//  - the encoder prints name/uname verbatim: callers pass printable ASCII without '"' or '\'.
#pragma once
// PetMirror: a DisplayDriver that draws into memory instead of onto the OLED, plus an encoder that
// turns each frame into one short text line for the dashboard page (watch the pet on a big screen).
//
// Line format (one JSON object per line, only while a dashboard page is asking for it):
//   {"pet":{"s":SEQ,"k":KEY,"d":"BASE64"}}                                  a frame
//   ... plus  "n":"fox","x":SEX,"m":MONTHS,"c":COUNT,"i":INDEX              on key frames
// The frame is 128x64 pixels, 16 bytes a row, top row first, leftmost pixel = top bit.  Unless KEY is 1
// the data is the XOR with the previous frame.  The bytes are run-length coded: a 0x00 is followed by
// how many zero bytes it stands for (1..255); every other byte stands for itself.

#include <helpers/ui/DisplayDriver.h>
#include <stdint.h>
#include <stdio.h>
#include <string.h>

#define PM_W 128
#define PM_H 64
#define PM_BYTES (PM_W / 8 * PM_H)

// the classic Adafruit 5x7 font, characters 32..126 (five columns each, bit 0 = top row)
static const uint8_t pm_font[] = {
  0x00, 0x00, 0x00, 0x00, 0x00, 0x00, 0x00, 0x5F, 0x00, 0x00, 0x00, 0x07, 0x00, 0x07, 0x00,
  0x14, 0x7F, 0x14, 0x7F, 0x14, 0x24, 0x2A, 0x7F, 0x2A, 0x12, 0x23, 0x13, 0x08, 0x64, 0x62,
  0x36, 0x49, 0x56, 0x20, 0x50, 0x00, 0x08, 0x07, 0x03, 0x00, 0x00, 0x1C, 0x22, 0x41, 0x00,
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  0x00, 0x41, 0x36, 0x08, 0x00, 0x02, 0x01, 0x02, 0x04, 0x02
};

class PetMirror : public DisplayDriver {
public:
  uint8_t fb[PM_BYTES];
  PetMirror() : DisplayDriver(PM_W, PM_H), _sz(1), _cx(0), _cy(0) { memset(fb, 0, sizeof(fb)); }

  bool isOn() override { return true; }
  void turnOn() override {}
  void turnOff() override {}
  void clear() override { memset(fb, 0, sizeof(fb)); }
  void startFrame(ColorVal = 0) override { memset(fb, 0, sizeof(fb)); _sz = 1; _cx = _cy = 0; }
  void endFrame() override {}
  void setTextSize(int sz) override { _sz = sz < 1 ? 1 : sz; }
  void setColor(ColorVal) override {}
  void setCursor(int x, int y) override { _cx = x; _cy = y; }
  uint16_t getTextWidth(const char* s) override { return (uint16_t)(strlen(s) * 6 * _sz); }
  void print(const char* s) override {
    for (; *s; s++) {
      unsigned char ch = (unsigned char)*s;
      if (ch >= 32 && ch <= 126) {
        const uint8_t* g = pm_font + (ch - 32) * 5;
        for (int col = 0; col < 5; col++)
          for (int row = 0; row < 7; row++)
            if (g[col] & (1 << row)) fillRect(_cx + col * _sz, _cy + row * _sz, _sz, _sz);
      }
      _cx += 6 * _sz;
    }
  }
  void fillRect(int x, int y, int w, int h) override {
    for (int j = y; j < y + h; j++) for (int i = x; i < x + w; i++) set(i, j);
  }
  void drawRect(int x, int y, int w, int h) override {
    fillRect(x, y, w, 1); fillRect(x, y + h - 1, w, 1); fillRect(x, y, 1, h); fillRect(x + w - 1, y, 1, h);
  }
  void drawXbm(int x, int y, const uint8_t* bits, int w, int h) override {
    int stride = (w + 7) / 8;
    for (int j = 0; j < h; j++) for (int i = 0; i < w; i++)
      if (bits[j * stride + (i >> 3)] & (0x80 >> (i & 7))) set(x + i, y + j);
  }

private:
  int _sz, _cx, _cy;
  void set(int x, int y) { if (x >= 0 && x < PM_W && y >= 0 && y < PM_H) fb[y * (PM_W / 8) + (x >> 3)] |= 0x80 >> (x & 7); }
};

// Turns frames into dashboard lines.  Call line() for every frame; it returns 0 when there is
// nothing worth sending (the picture did not change).
struct PetMirrorEncoder {
  uint8_t prev[PM_BYTES];
  uint32_t seq, last_call, last_sent, frames_since_key;
  PetMirrorEncoder() : seq(0), last_call(0), last_sent(0), frames_since_key(0xFFFF) { memset(prev, 0, sizeof(prev)); }

  static size_t b64(const uint8_t* in, size_t n, char* out) {
    static const char T[] = "ABCDEFGHIJKLMNOPQRSTUVWXYZabcdefghijklmnopqrstuvwxyz0123456789+/";
    size_t o = 0;
    for (size_t i = 0; i < n; i += 3) {
      uint32_t v = (uint32_t)in[i] << 16 | (i + 1 < n ? (uint32_t)in[i + 1] << 8 : 0) | (i + 2 < n ? in[i + 2] : 0);
      out[o++] = T[(v >> 18) & 63]; out[o++] = T[(v >> 12) & 63];
      out[o++] = i + 1 < n ? T[(v >> 6) & 63] : '=';
      out[o++] = i + 2 < n ? T[v & 63] : '=';
    }
    return o;
  }

  // meta fields only go out on key frames
  size_t line(const uint8_t* fb, uint32_t now, char* out, size_t cap, const char* name, int sex, int months, int count, int index, const char* uname = "") {
    if (cap < 2000) return 0;
    bool key = frames_since_key >= 40 || (uint32_t)(now - last_call) > 1500;     // first frame, every ~5 s, or after a pause
    last_call = now;
    static uint8_t d[PM_BYTES], rle[PM_BYTES + 8];
    bool any = false;
    for (int i = 0; i < PM_BYTES; i++) { d[i] = key ? fb[i] : (uint8_t)(fb[i] ^ prev[i]); if (d[i]) any = true; }
    if (!key && !any && (uint32_t)(now - last_sent) < 1000) return 0;
    size_t n = 0;
    for (int i = 0; i < PM_BYTES;) {
      if (d[i]) { rle[n++] = d[i++]; continue; }
      int run = 0; while (i < PM_BYTES && !d[i] && run < 255) { run++; i++; }
      rle[n++] = 0; rle[n++] = (uint8_t)run;
    }
    int w = snprintf(out, cap, "{\"pet\":{\"s\":%lu,\"k\":%d,", (unsigned long)(++seq), key ? 1 : 0);
    if (key) w += snprintf(out + w, cap - w, "\"n\":\"%s\",\"u\":\"%s\",\"x\":%d,\"m\":%d,\"c\":%d,\"i\":%d,", name, uname ? uname : "", sex, months, count, index);
    w += snprintf(out + w, cap - w, "\"d\":\"");
    w += (int)b64(rle, n, out + w);
    w += snprintf(out + w, cap - w, "\"}}");
    memcpy(prev, fb, PM_BYTES);
    frames_since_key = key ? 0 : frames_since_key + 1;
    last_sent = now;
    return (size_t)w;
  }
};
